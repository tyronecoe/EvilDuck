// Actual composed USB observer/backend with RAM-only SDK and transport mocks.
#include "define_labels_parent_cases.inc"
#include "device/dcd.h"
#include <array>
#include <thread>

namespace usb_observer {extern std::mutex captureMux;}

static dcd_event_t oe(uint8_t kind,uint8_t port=0){dcd_event_t e;memset(&e,0xa5,sizeof(e));e.rhport=port;e.event_id=kind;if(kind==DCD_EVENT_BUS_RESET)e.bus_reset.speed=TUSB_SPEED_FULL;return e;}
static dcd_event_t oq(uint8_t type=0x80,uint8_t request=6,uint16_t value=0x1234,uint16_t index=0x5678,uint16_t length=0x9abc,uint8_t port=0){auto e=oe(DCD_EVENT_SETUP_RECEIVED,port);const uint8_t b[]={type,request,uint8_t(value),uint8_t(value>>8),uint8_t(index),uint8_t(index>>8),uint8_t(length),uint8_t(length>>8)};memcpy(&e.setup_received,b,8);return e;}
static void of(dcd_event_t& e,bool isr=false){std::array<uint8_t,sizeof(e)> old{};memcpy(old.data(),&e,sizeof(e));auto n=evilduck_mock_dcd_calls();__wrap_dcd_event_handler(&e,isr);check(evilduck_mock_dcd_calls()==n+1&&evilduck_mock_dcd_last()==&e&&evilduck_mock_dcd_last_isr()==isr,"original event and ISR argument forwarded exactly once");check(memcmp(old.data(),&e,sizeof(e))==0,"original event storage including unused poisoned union remains unchanged");}
static void ob(){usb_observer::resetForTest();evilduck_mock_dcd_reset();auto e=oe(DCD_EVENT_BUS_RESET);of(e,true);}
static void oneSetup(){auto q=oq();of(q,true);}
static usb_observer::Snapshot os(){return usb_observer::snapshot();}
static void zeroRecords(const usb_observer::Snapshot& s){for(unsigned i=s.count;i<usb_observer::MaxRecords;++i){auto&r=s.records[i];check(r.order==0&&r.wValue==0&&r.wIndex==0&&r.wLength==0&&r.port==0&&r.bmRequestType==0&&r.bRequest==0,"unused metadata records contain only initialized zeros");}}
int main(int argc,char**argv){
 if(argc!=2)return 2;
 try{
  const std::string id=argv[1];
  if(id=="UO01"){
   auto s=os();check(s.state==usb_observer::State::Boot&&s.generation==0&&s.count==0&&!s.windowStarted&&!s.windowClosed,"constant/BSS initial capture exists before setup or payload");zeroRecords(s);check(sizeof(usb_observer::Record)<=16&&sizeof(usb_observer::Snapshot)<2048,"fixed64records bounded independently from compiler workspace");
  }else if(id=="UO02"){
   ob();oneSetup();auto s=os();check(s.generation==1&&s.resets==1&&s.count==1&&s.observed==1&&!s.windowStarted,"initial enumeration captured before foreground service");const auto&r=s.records[0];check(r.order==1&&r.port==0&&r.bmRequestType==0x80&&r.bRequest==6&&r.wValue==0x1234&&r.wIndex==0x5678&&r.wLength==0x9abc,"exact eight request bytes decoded little-endian without payload");zeroRecords(s);
  }else if(id=="UO03"){
   ob();for(uint8_t type:{uint8_t(0x80),uint8_t(0x81)})for(uint8_t code:{uint8_t(0),uint8_t(6),uint8_t(8),uint8_t(10)}){auto e=oq(type,code);of(e);}for(uint8_t type:{uint8_t(0),uint8_t(1)})for(uint8_t code:{uint8_t(1),uint8_t(3),uint8_t(5),uint8_t(9),uint8_t(11)}){auto e=oq(type,code);of(e);}auto s=os();check(s.count==18&&s.observed==18&&s.ignored==0,"only documented standard-device/interface header classes recorded");
  }else if(id=="UO04"){
   ob();for(auto pair:{std::pair<uint8_t,uint8_t>{0xa1,1},{0x21,9},{0x21,10},{0x21,11}}){auto e=oq(pair.first,pair.second);of(e,true);}for(auto pair:{std::pair<uint8_t,uint8_t>{0xc0,6},{0x40,9},{0xa1,9},{0x21,1},{0x82,6},{0x02,3},{0x80,255}}){auto e=oq(pair.first,pair.second);of(e);}auto s=os();check(s.count==4&&s.observed==11&&s.ignored==7&&s.unsupported==3&&s.unsupportedReasons==3,"supported headers retained; excluded and unsupported request categories remain separate");
  }else if(id=="UO05"){
   ob();oneSetup();auto before=os();for(uint8_t kind:{uint8_t(3),uint8_t(4),uint8_t(5),uint8_t(7),uint8_t(8)}){auto e=oe(kind);of(e,true);}auto after=os();check(before.observed==after.observed&&before.ignored==after.ignored&&before.count==after.count&&before.state==after.state&&after.unsupported==0&&after.unsupportedReasons==0,"SOF/transfers/function calls/suspend/resume never collect data or activity counters");check(after.records[0].wLength==0x9abc,"poisoned unrelated union fields do not replace captured setup");
  }else if(id=="UO06"){
   ob();auto q=oq(0x80,6,1,2,3,1);of(q,true);auto reset=oe(DCD_EVENT_BUS_RESET,1);of(reset);auto n=evilduck_mock_dcd_calls();__wrap_dcd_event_handler(nullptr,true);check(evilduck_mock_dcd_calls()==n+1&&evilduck_mock_dcd_last()==nullptr,"null event still forwarded without observer dereference");auto s=os();check(s.count==0&&s.generation==1&&s.observed==0,"foreign controller does not taint fixed root-port observation");
  }else if(id=="UO07"){
   usb_observer::resetForTest();evilduck_mock_dcd_reset();oneSetup();usb_observer::service(10,true);usb_observer::service(5010,true);auto s=os();check(s.missingReset&&s.state==usb_observer::State::Incomplete&&s.count==1,"late/missing-reset capture remains incomplete rather than fabricating complete evidence");
  }else if(id=="UO08"){
   ob();oneSetup();usb_observer::service(100,true);usb_observer::service(5099,true);check(os().state==usb_observer::State::Capturing,"window remains open at4999ms");usb_observer::service(5100,true);auto s=os();check(s.state==usb_observer::State::Complete&&s.windowStarted&&s.windowClosed&&s.configured&&s.windowStartedMs==100&&s.windowFinishedMs==5100,"5000ms foreground boundary closes coherent configured snapshot");oneSetup();auto after=os();check(after.count==s.count&&after.observed==s.observed&&after.ignored==s.ignored,"closed window collects no later request metadata or counts");
  }else if(id=="UO09"){
   ob();for(unsigned i=0;i<64;++i){auto q=oq(0x80,6,i);of(q);}auto s=os();check(s.count==64&&!s.overflow&&s.observed==64,"exact64 headers fit without overwriting");for(unsigned i=0;i<64;++i)check(s.records[i].wValue==i&&s.records[i].order==i+1,"first-record order retained");usb_observer::service(0,true);usb_observer::service(5000,true);check(os().state==usb_observer::State::Complete,"full bounded snapshot may complete");
  }else if(id=="UO10"){
   ob();for(unsigned i=0;i<65;++i){auto q=oq(0x80,6,i);of(q);}auto s=os();check(s.count==64&&s.observed==65&&s.overflow&&s.windowClosed&&s.state==usb_observer::State::Overflow,"65th permitted header exhausts capture without overwriting");check(s.records[0].wValue==0&&s.records[63].wValue==63,"overflow retains original first64");usb_observer::service(10000,true);oneSetup();check(os().state==usb_observer::State::Overflow&&os().observed==65,"overflow never becomes successful evidence");
  }else if(id=="UO11"){
   ob();oneSetup();usb_observer::service(0,false);usb_observer::service(5000,false);check(os().state==usb_observer::State::Incomplete&&!os().configured,"not configured at deadline stays inconclusive");usb_observer::service(6000,true);check(os().state==usb_observer::State::Incomplete,"late configured state does not reopen closed snapshot");
  }else if(id=="UO12"){
   ob();oneSetup();usb_observer::service(0,true);usb_observer::service(5000,true);auto e=oe(DCD_EVENT_BUS_RESET);e.bus_reset.speed=TUSB_SPEED_HIGH;of(e,true);auto s=os();check(s.generation==2&&s.resets==2&&s.state==usb_observer::State::Capturing&&s.speed==2&&!s.windowStarted&&!s.configured&&s.count==0,"new reset invalidates prior generation and observation window");zeroRecords(s);
  }else if(id=="UO13"){
   ob();oneSetup();auto e=oe(DCD_EVENT_UNPLUGGED);of(e,true);auto s=os();check(s.generation==2&&s.unplugs==1&&s.state==usb_observer::State::Unplugged&&s.windowClosed&&s.count==0,"unplug invalidates observation and clears prior headers");zeroRecords(s);oneSetup();check(os().missingReset&&os().generation==3,"setup after missing reconnect reset remains flagged");
  }else if(id=="UO14"){
   ob();oneSetup();usb_observer::service(UINT32_MAX-100,true);usb_observer::service(4899,true);check(os().state==usb_observer::State::Complete,"natural uint32 millisecond wrap preserves5000ms window");ob();oneSetup();usb_observer::service(100,true);usb_observer::service(99,true);check(os().clockError&&os().state==usb_observer::State::ClockError&&os().windowClosed,"backward foreground clock invalidates rather than wraps deadline");
  }else if(id=="UO15"){
   ob();usb_observer::generationForTest(UINT32_MAX);auto e=oe(DCD_EVENT_BUS_RESET);of(e,true);auto s=os();check(s.generation==UINT32_MAX&&s.exhausted&&s.state==usb_observer::State::Exhausted,"generation exhaustion cannot wrap into an old epoch");oneSetup();check(os().count==0,"exhausted generation admits no metadata");
  }else if(id=="UO16"){
   ob();usb_observer::countersForTest(UINT32_MAX,0,1,0);oneSetup();check(os().exhausted&&os().observed==UINT32_MAX,"setup count saturates without wrapping");ob();usb_observer::countersForTest(0,UINT32_MAX,1,0);auto q=oq(0xc0,1);of(q);check(os().exhausted&&os().ignored==UINT32_MAX,"filtered setup count exhaustion is explicit");ob();usb_observer::countersForTest(0,0,UINT32_MAX,0);auto r=oe(DCD_EVENT_BUS_RESET);of(r);check(os().exhausted,"reset counter exhaustion refuses a false new generation");ob();usb_observer::countersForTest(0,0,1,UINT32_MAX);auto u=oe(DCD_EVENT_UNPLUGGED);of(u);check(os().exhausted,"unplug counter exhaustion cannot wrap");
  }else if(id=="UO17"){
   ob();auto e=oq();const auto before=native_alloc::calls();__wrap_dcd_event_handler(&e,true);check(native_alloc::calls()==before,"observer callback performs no C++heap allocation");auto s=os();check(s.count==1&&s.records[0].wValue==0x1234,"fixed data captured without device or file calls");
  }else if(id=="UO18"){
   ob();auto producer=[](){for(unsigned i=0;i<20;++i){auto e=oq();__wrap_dcd_event_handler(&e,true);}};std::thread a(producer),b(producer);for(unsigned i=0;i<20;++i){auto s=os();check(s.count<=40&&s.generation==1,"foreground snapshots remain bounded during concurrent producers");}a.join();b.join();auto s=os();check(s.count==40&&s.observed==40&&evilduck_mock_dcd_calls()==41,"synthetic concurrent event entries forward once and retain40headers");for(unsigned i=0;i<40;++i)check(s.records[i].order==i+1,"coherent monotonically ordered record publication");
  }else if(id=="UO19"){
   nvsMock::reset();mscMock::reset();mock::reset();setup();check(startupControlledReady&&route_u::bindOwner(),"actual controlled owner starts");lower::reset();ob();oneSetup();completed("STRING a\n");oneA();check(os().count==1&&os().observed==1,"normal HID reports are not captured as USBsetup records");
  }else if(id=="UO20"){
   nvsMock::reset();mscMock::reset();mock::reset();setup();check(startupControlledReady&&route_u::bindOwner(),"actual owner starts for STOP");lower::reset();ob();oneSetup();put("/x.txt","HOLD RSHIFT\nDELAY 10000\nSTRING BAD\n");start();reports(1);route_u::stop();prCancelled();check(os().count==1&&os().observed==1,"STOP cleanup leaves no report payloads in metadata");lower::reset();completed("STRING a\n");oneA();
  }else if(id=="UO21"){
   ob();oneSetup();usb_observer::service(0,true);usb_observer::service(5000,true);usb_observer::service(5001,false);check(os().state==usb_observer::State::Incomplete&&!os().configured,"loss of configured transport invalidates completed evidence");
  }else if(id=="UO22"){
   ob();auto q=oq(0x81,6,0xffff,0xffff,0xffff);of(q,true);auto s=os();check(s.records[0].wValue==65535&&s.records[0].wIndex==65535&&s.records[0].wLength==65535,"16bit header endpoints retained exactly without fetching pointed data");for(auto state:{usb_observer::State::Boot,usb_observer::State::Capturing,usb_observer::State::Complete,usb_observer::State::Overflow,usb_observer::State::Unplugged,usb_observer::State::Exhausted,usb_observer::State::ClockError,usb_observer::State::Incomplete,usb_observer::State::Unsupported})check(strlen(usb_observer::stateName(state))>0,"every capture state has bounded diagnostic label");
  }else if(id=="UO23"){
   ob();oneSetup();auto s=os();const uint8_t* b=reinterpret_cast<const uint8_t*>(&s.records[0]);for(size_t n=13;n<sizeof(usb_observer::Record);++n)check(b[n]==0,"stored record tail padding cannot retain source/event/stack bytes");zeroRecords(s);
  }else if(id=="UO24"){
   ob();auto before=os();std::unique_lock<std::mutex> held(usb_observer::captureMux);auto e=oe(DCD_EVENT_XFER_COMPLETE);of(e,true);auto q=oe(DCD_EVENT_SOF);of(q,true);held.unlock();auto after=os();check(before.observed==after.observed&&before.ignored==after.ignored,"unrelated HID/CDC completion and SOF callbacks forward without taking observer mutex");
  }else if(id=="UO25"){
   ob();oneSetup();auto standard=oq(0x80,255),hid=oq(0xa1,9);of(standard,true);of(hid,true);auto s=os();check(s.count==1&&s.observed==3&&s.ignored==2&&s.unsupported==2&&s.unsupportedReasons==3,"unsupported interpretation is explicit and never inserted into raw supported records");check(s.records[0].wValue==0x1234&&s.state==usb_observer::State::Capturing,"relevant unsupported headers do not discard the bounded raw prefix or prematurely close");usb_observer::service(10,true);usb_observer::service(5010,true);s=os();check(s.state==usb_observer::State::Unsupported&&s.windowClosed&&s.windowFinishedMs==5010,"unsupported evidence cannot become COMPLETE at deadline");
  }else if(id=="UO26"){
   ob();oneSetup();for(auto p:{std::pair<uint8_t,uint8_t>{0x21,0x20},{0xa1,0x21}}){auto q=oq(p.first,p.second,0,0,7);of(q,true);}for(auto p:{std::pair<uint8_t,uint8_t>{0x21,0x22},{0x21,0x23}}){auto q=oq(p.first,p.second,3,0,0);of(q,true);}for(auto p:{std::pair<uint8_t,uint8_t>{0xc0,6},{0x40,9},{0x82,6},{0x02,3}}){auto q=oq(p.first,p.second);of(q,true);}auto s=os();check(s.count==1&&s.observed==9&&s.ignored==8&&s.unsupported==0&&s.unsupportedReasons==0,"declared CDC-shaped, vendor and endpoint exclusions do not poison selected enumeration-header evidence");usb_observer::service(0,true);usb_observer::service(5000,true);check(os().state==usb_observer::State::Complete,"unrelated excluded headers do not prevent a completed capture");ob();for(auto q:{oq(0x21,0x20,0,0,6),oq(0xa1,0x21,1,0,7),oq(0x21,0x22,4,0,0),oq(0x21,0x23,0,256,0)})of(q,true);s=os();check(s.unsupported==4&&s.unsupportedReasons==2&&s.ignored==4&&s.count==0,"malformed or unhandled CDC-shaped class-interface requests remain relevant unsupported");
  }else if(id=="UO27"){
   ob();oneSetup();for(uint8_t kind:{uint8_t(DCD_EVENT_INVALID),uint8_t(DCD_EVENT_COUNT),uint8_t(255)}){auto e=oe(kind);of(e,true);}auto s=os();check(s.unsupported==3&&s.unsupportedReasons==4&&s.count==1&&s.observed==1&&s.ignored==0,"unknown DCD event identities flagged without interpreting poisoned unions or miscounting SETUP");usb_observer::service(UINT32_MAX-4999,true);usb_observer::service(0,true);s=os();check(s.state==usb_observer::State::Unsupported&&s.windowFinishedMs==0&&s.windowClosed,"unsupported deadline timestamp zero is a legitimate wrap endpoint");
  }else if(id=="UO28"){
   ob();oneSetup();auto q=oq(0x80,255);of(q,true);auto e=oe(DCD_EVENT_BUS_RESET);of(e,true);auto s=os();check(s.generation==2&&s.count==0&&s.unsupported==0&&s.unsupportedReasons==0,"reset separates unsupported reasons from the fresh generation");oneSetup();usb_observer::service(0,true);usb_observer::service(5000,true);check(os().state==usb_observer::State::Complete,"clean subsequent generation can complete without inheriting prior interpretation limits");e=oe(DCD_EVENT_UNPLUGGED);of(e,true);check(os().unsupported==0&&os().unsupportedReasons==0&&os().count==0,"unplug clears prior evidence and reasons together");
  }else if(id=="UO29"){
   ob();usb_observer::unsupportedForTest(UINT32_MAX,1);auto q=oq(0xa1,9);of(q,true);auto s=os();check(s.exhausted&&s.unsupported==UINT32_MAX&&s.unsupportedReasons==3&&s.state==usb_observer::State::Exhausted,"unsupported count saturates explicitly without erasing accumulated reason bits");ob();oneSetup();usb_observer::service(0,true);usb_observer::service(5000,true);auto e=oe(255);of(e,true);s=os();check(s.state==usb_observer::State::Complete&&s.unsupported==0&&s.unsupportedReasons==0,"events after bounded closure do not silently reopen or mutate a completed capture");
  }else if(id=="UO30"){
   usb_observer::resetForTest();evilduck_mock_dcd_reset();auto e=oe(255);of(e,true);oneSetup();auto s=os();check(s.missingReset&&s.unsupported==1&&s.unsupportedReasons==4&&s.generation==1,"unrecognized early event establishes only an explicitly incomplete generation, not a fabricated reset");usb_observer::service(0,true);usb_observer::service(5000,true);check(os().state==usb_observer::State::Unsupported&&os().missingReset,"missing-reset and unsupported reasons coexist and neither yields complete evidence");
  }else check(false,"unknown observer case");
  std::cout<<"PASS "<<id<<" ("<<assertions<<" assertions)\n";return 0;
 }catch(const std::exception&e){std::cerr<<"FAIL "<<argv[1]<<": "<<e.what()<<" ("<<assertions<<")\n";return 1;}
}
